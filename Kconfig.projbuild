## Kconfig.projbuild
```kconfig
menu "Example Configuration"

    config ESP_WIFI_SSID
        string "WiFi SSID"
        default "myssid"
        help
            SSID (network name) for the example to connect to.

    config ESP_WIFI_PASSWORD
        string "WiFi Password"
        default "mypassword"
        help
            WiFi password (WPA or WPA2) for the example to use.

    config ESP_MAXIMUM_RETRY
        int "Maximum retry"
        default 5
        help
            Set the Maximum retry to avoid station reconnecting to the AP unlimited when the AP is really inexistent.

    config BROKER_URL
        string "Broker URL"
        default "mqtt://mqtt.eclipse.org"
        help
            URL of the broker to connect to

    config BROKER_URL_FROM_STDIN
        bool
        default y if BROKER_URL = "FROM_STDIN"

    config EXAMPLE_ONEWIRE_GPIO
            int "GPIO Number of 1-Wire bus, or DQ"
            default 4 if IDF_TARGET_ESP8266
            default 18 if IDF_TARGET_ESP32C3
            default 17 if IDF_TARGET_ESP32 || IDF_TARGET_ESP32S2 || IDF_TARGET_ESP32S3
            help
                GPIO Number of 1-Wire bus, or DQ. You might need an external
                pullup resistor on the bus. See README.md for details.

    config EXAMPLE_DS18X20_MAX_SENSORS
        int "Number of ds18x20 sensors on the 1-Wire bus"
        default 8
        help
            Max number of ds18x20 sensors on th 1-Wire bus. If number of
            sensors on the bus more than this value found on the bus, the rest
            of sensors will be ignored.


endmenu
```
